## CMakeLists.txt
```
# SPDX-License-Identifier: Apache-2.0
cmake_minimum_required(VERSION 3.20.0)
find_package(Zephyr REQUIRED HINTS $ENV{ZEPHYR_BASE})
project(lw_zephyr_l1_sleep)
target_sources(app PRIVATE src/main.c)
```

## prj.conf
```kconfig
CONFIG_PRINTK=y
CONFIG_CONSOLE=y
CONFIG_SERIAL=y
CONFIG_UART_CONSOLE=y
# Explicitly need kernel timer / SysTick (or SoC timer) for k_msleep.
CONFIG_SYS_CLOCK_EXISTS=y
```

## src/main.c
```c
/*
 * LabWired Zephyr matrix L1 — prove k_msleep / kernel tick advances.
 */
#include <zephyr/kernel.h>
#include <zephyr/sys/printk.h>

int main(void)
{
	printk("LW_Z1_BOOT\n");
	while (1) {
		k_msleep(50);
		printk("LW_Z1_OK\n");
	}
	return 0;
}
```
