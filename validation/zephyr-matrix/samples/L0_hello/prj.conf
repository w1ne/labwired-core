## CMakeLists.txt
```
# SPDX-License-Identifier: Apache-2.0
cmake_minimum_required(VERSION 3.20.0)
find_package(Zephyr REQUIRED HINTS $ENV{ZEPHYR_BASE})
project(lw_zephyr_l0_hello)
target_sources(app PRIVATE src/main.c)
```

## prj.conf
```kconfig
# Minimal console printk — no extra subsystems.
CONFIG_PRINTK=y
CONFIG_CONSOLE=y
CONFIG_SERIAL=y
CONFIG_UART_CONSOLE=y
```

## src/main.c
```c
/*
 * LabWired Zephyr matrix L0 — prove kernel + console after boot.
 * Marker must appear once; loop may idle.
 */
#include <zephyr/kernel.h>
#include <zephyr/sys/printk.h>

int main(void)
{
	printk("LW_Z0_OK\n");
	while (1) {
		k_sleep(K_FOREVER);
	}
	return 0;
}
```
