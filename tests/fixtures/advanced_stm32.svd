# ADVANCED_DEVICE register map
File version: 1.0
Registers are 32-bit, read-write, reset 0x0 unless marked. A register's access mark holds for its fields unless they carry their own. Offsets are from the block's base; lines under a group give offsets from that group; [hi:lo] are bit positions; {n}, {i} and the like mark numbered series; 'fields as' and 'values as' point back to an identical list; <NAME> marks a mode.

## Memory map
0x40001000 TIMER_BASE
0x40002000 TIMER1
0x40003000 CLUSTERS

## TIMER_BASE
Base 0x40001000
0x00 CR — Control Register

## TIMER1
Base 0x40002000
0x00 CR — Control Register
0x04 SR ro — Status Register

## CLUSTERS
Base 0x40003000
{0x0+0x10*i} GRP[{i}] (i=0..1) group
  0x00 REG access not given reset not defined
  {0x4+4j} REGS[{j}] (j=0..1) access not given reset not defined
