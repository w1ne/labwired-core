# ESP32-H2 register map
Vendor: ESPRESSIF SYSTEMS (SHANGHAI) CO., LTD.; Series: ESP32 H-Series; File version: 11
CPU: RV32IMAC r0p0, little endian, no MPU, no FPU, 0 interrupt priority bits
Address unit: 32 bits
Registers are 32-bit, read-write, reset 0x0 unless marked. A register's access mark holds for its fields unless they carry their own. Offsets are from the block's base; [hi:lo] are bit positions; {n}, {i} and the like mark numbered series.

## INTERRUPT_CORE0 — Interrupt Controller (Core 0)
Base 0x60010000
0x00 PMU_INTR_MAP — register description
  [4:0] PMU_INTR_MAP — CORE0_PMU_INTR mapping register
0x04 EFUSE_INTR_MAP — register description
  [4:0] EFUSE_INTR_MAP — CORE0_EFUSE_INTR mapping register
0x08 LP_RTC_TIMER_INTR_MAP — register description
  [4:0] LP_RTC_TIMER_INTR_MAP — CORE0_LP_RTC_TIMER_INTR mapping register
0x0C LP_BLE_TIMER_INTR_MAP — register description
  [4:0] LP_BLE_TIMER_INTR_MAP — CORE0_LP_BLE_TIMER_INTR mapping register
0x10 LP_WDT_INTR_MAP — register description
  [4:0] LP_WDT_INTR_MAP — CORE0_LP_WDT_INTR mapping register
0x14 LP_PERI_TIMEOUT_INTR_MAP — register description
  [4:0] LP_PERI_TIMEOUT_INTR_MAP — CORE0_LP_PERI_TIMEOUT_INTR mapping register
0x18 LP_APM_M0_INTR_MAP — register description
  [4:0] LP_APM_M0_INTR_MAP — CORE0_LP_APM_M0_INTR mapping register
{0x1C+4i} CPU_INTR_FROM_CPU_{i}_MAP (i=0..3) — register description
  [4:0] CPU_INTR_FROM_CPU_{i}_MAP — CORE0_CPU_INTR_FROM_CPU_{i} mapping register
0x2C ASSIST_DEBUG_INTR_MAP — register description
  [4:0] ASSIST_DEBUG_INTR_MAP — CORE0_ASSIST_DEBUG_INTR mapping register
0x30 TRACE_INTR_MAP — register description
  [4:0] TRACE_INTR_MAP — CORE0_TRACE_INTR mapping register
0x34 CACHE_INTR_MAP — register description
  [4:0] CACHE_INTR_MAP — CORE0_CACHE_INTR mapping register
0x38 CPU_PERI_TIMEOUT_INTR_MAP — register description
  [4:0] CPU_PERI_TIMEOUT_INTR_MAP — CORE0_CPU_PERI_TIMEOUT_INTR mapping register
0x3C BT_MAC_INTR_MAP — register description
  [4:0] BT_MAC_INTR_MAP — CORE0_BT_MAC_INTR mapping register
0x40 BT_BB_INTR_MAP — register description
  [4:0] BT_BB_INTR_MAP — CORE0_BT_BB_INTR mapping register
0x44 BT_BB_NMI_MAP — register description
  [4:0] BT_BB_NMI_MAP — CORE0_BT_BB_NMI mapping register
0x48 COEX_INTR_MAP — register description
  [4:0] COEX_INTR_MAP — CORE0_COEX_INTR mapping register
0x4C BLE_TIMER_INTR_MAP — register description
  [4:0] BLE_TIMER_INTR_MAP — CORE0_BLE_TIMER_INTR mapping register
0x50 BLE_SEC_INTR_MAP — register description
  [4:0] BLE_SEC_INTR_MAP — CORE0_BLE_SEC_INTR mapping register
0x54 ZB_MAC_INTR_MAP — register description
  [4:0] ZB_MAC_INTR_MAP — CORE0_ZB_MAC_INTR mapping register
0x58 GPIO_INTERRUPT_PRO_MAP — register description
  [4:0] GPIO_INTERRUPT_PRO_MAP — CORE0_GPIO_INTERRUPT_PRO mapping register
0x5C GPIO_INTERRUPT_PRO_NMI_MAP — register description
  [4:0] GPIO_INTERRUPT_PRO_NMI_MAP — CORE0_GPIO_INTERRUPT_PRO_NMI mapping register
0x60 PAU_INTR_MAP — register description
  [4:0] PAU_INTR_MAP — CORE0_PAU_INTR mapping register
0x64 HP_PERI_TIMEOUT_INTR_MAP — register description
  [4:0] HP_PERI_TIMEOUT_INTR_MAP — CORE0_HP_PERI_TIMEOUT_INTR mapping register
{0x68+4i} HP_APM_M{i}_INTR_MAP (i=0..3) — register description
  [4:0] HP_APM_M{i}_INTR_MAP — CORE0_HP_APM_M{i}_INTR mapping register
0x78 MSPI_INTR_MAP — register description
  [4:0] MSPI_INTR_MAP — CORE0_MSPI_INTR mapping register
0x7C I2S1_INTR_MAP — register description
  [4:0] I2S1_INTR_MAP — CORE0_I2S1_INTR mapping register
0x80 UHCI0_INTR_MAP — register description
  [4:0] UHCI0_INTR_MAP — CORE0_UHCI0_INTR mapping register
0x84 UART0_INTR_MAP — register description
  [4:0] UART0_INTR_MAP — CORE0_UART0_INTR mapping register
0x88 UART1_INTR_MAP — register description
  [4:0] UART1_INTR_MAP — CORE0_UART1_INTR mapping register
0x8C LEDC_INTR_MAP — register description
  [4:0] LEDC_INTR_MAP — CORE0_LEDC_INTR mapping register
0x90 CAN0_INTR_MAP — register description
  [4:0] CAN0_INTR_MAP — CORE0_CAN0_INTR mapping register
0x94 USB_INTR_MAP — register description
  [4:0] USB_INTR_MAP — CORE0_USB_INTR mapping register
0x98 RMT_INTR_MAP — register description
  [4:0] RMT_INTR_MAP — CORE0_RMT_INTR mapping register
0x9C I2C_EXT0_INTR_MAP — register description
  [4:0] I2C_EXT0_INTR_MAP — CORE0_I2C_EXT0_INTR mapping register
0xA0 I2C_EXT1_INTR_MAP — register description
  [4:0] I2C_EXT1_INTR_MAP — CORE0_I2C_EXT1_INTR mapping register
0xA4 TG0_T0_INTR_MAP — register description
  [4:0] TG0_T0_INTR_MAP — CORE0_TG0_T0_INTR mapping register
0xA8 TG0_WDT_INTR_MAP — register description
  [4:0] TG0_WDT_INTR_MAP — CORE0_TG0_WDT_INTR mapping register
0xAC TG1_T0_INTR_MAP — register description
  [4:0] TG1_T0_INTR_MAP — CORE0_TG1_T0_INTR mapping register
0xB0 TG1_WDT_INTR_MAP — register description
  [4:0] TG1_WDT_INTR_MAP — CORE0_TG1_WDT_INTR mapping register
{0xB4+4i} SYSTIMER_TARGET{i}_INTR_MAP (i=0..2) — register description
  [4:0] SYSTIMER_TARGET{i}_INTR_MAP — CORE0_SYSTIMER_TARGET{i}_INTR mapping register
0xC0 APB_ADC_INTR_MAP — register description
  [4:0] APB_ADC_INTR_MAP — CORE0_APB_ADC_INTR mapping register
0xC4 PWM_INTR_MAP — register description
  [4:0] PWM_INTR_MAP — CORE0_PWM_INTR mapping register
0xC8 PCNT_INTR_MAP — register description
  [4:0] PCNT_INTR_MAP — CORE0_PCNT_INTR mapping register
0xCC PARL_IO_TX_INTR_MAP — register description
  [4:0] PARL_IO_TX_INTR_MAP — CORE0_PARL_IO_TX_INTR mapping register
0xD0 PARL_IO_RX_INTR_MAP — register description
  [4:0] PARL_IO_RX_INTR_MAP — CORE0_PARL_IO_RX_INTR mapping register
{0xD4+4i} DMA_IN_CH{i}_INTR_MAP (i=0..2) — register description
  [4:0] DMA_IN_CH{i}_INTR_MAP — CORE0_DMA_IN_CH{i}_INTR mapping register
{0xE0+4i} DMA_OUT_CH{i}_INTR_MAP (i=0..2) — register description
  [4:0] DMA_OUT_CH{i}_INTR_MAP — CORE0_DMA_OUT_CH{i}_INTR mapping register
0xEC GPSPI2_INTR_MAP — register description
  [4:0] GPSPI2_INTR_MAP — CORE0_GPSPI2_INTR mapping register
0xF0 AES_INTR_MAP — register description
  [4:0] AES_INTR_MAP — CORE0_AES_INTR mapping register
0xF4 SHA_INTR_MAP — register description
  [4:0] SHA_INTR_MAP — CORE0_SHA_INTR mapping register
0xF8 RSA_INTR_MAP — register description
  [4:0] RSA_INTR_MAP — CORE0_RSA_INTR mapping register
0xFC ECC_INTR_MAP — register description
  [4:0] ECC_INTR_MAP — CORE0_ECC_INTR mapping register
0x100 ECDSA_INTR_MAP — register description
  [4:0] ECDSA_INTR_MAP — CORE0_ECDSA_INTR mapping register
0x104 INTR_STATUS_REG_0 ro — register description
  [31:0] INTR_STATUS_0 — Status register for interrupt sources 0~31 mapping register
0x108 INTR_STATUS_REG_1 ro — register description
  [31:0] INTR_STATUS_1 — Status register for interrupt sources 32~63 mapping register
0x10C INT_STATUS_REG_2 ro — register description
  [31:0] INT_STATUS_2 — Status register for interrupt sources 64~95 mapping register
0x110 CLOCK_GATE reset 0x1 — register description
  [0] REG_CLK_EN — Clock register
0x7FC INTERRUPT_REG_DATE reset 0x2209150 — register description
  [27:0] INTERRUPT_REG_DATE — Version control register
