# STM32F103 register map
File version: 1.0
STM32F103xx
Registers are 32-bit, read-write, reset 0x44444444 unless marked. A register's access mark holds for its fields unless they carry their own. Offsets are from the block's base; lines under a group give offsets from that group; [hi:lo] are bit positions; {n}, {i} and the like mark numbered series; 'fields as' and 'values as' point back to an identical list; <NAME> marks a mode.

## Memory map
0x40010800 GPIOA size 0x400

## Interrupts
6 EXTI0 (GPIOA)

## GPIOA
Base 0x40010800
0x00 CRL — Port configuration register low (GPIOx_CRL)
  [1:0] MODE0 — Port x mode bits
