## examples/esp32c3-oled-demo/sdkconfig.defaults
```kconfig
# Keep the image small and the boot deterministic for the browser twin.
CONFIG_IDF_TARGET="esp32c3"
# Single-app layout, no OTA — smallest partition table.
CONFIG_PARTITION_TABLE_SINGLE_APP=y
# Log through the default console so the rom-boot test can see the banners.
CONFIG_BOOTLOADER_LOG_LEVEL_INFO=y
CONFIG_LOG_DEFAULT_LEVEL_INFO=y
```

## third_party/iolinki-master/west.yml
```yaml
# Copyright (C) 2026 Andrii Shylenko
# SPDX-License-Identifier: GPL-3.0-or-later
#
# Standalone west manifest for iolinki-master.
#
# This manifest lets you use iolinki-master as the manifest repository of a
# fresh west workspace, pulling in Zephyr and the iolinki device stack (which
# supplies the shared frame/CRC helpers and public headers) alongside it:
#
#     west init -m https://github.com/w1ne/iolinki-master --mr main iolinki-ws
#     cd iolinki-ws
#     west update
#     west build -b native_sim iolinki-master/samples/iolink_master
#
# The pinned Zephyr revision below tracks Zephyr 'main'; the master core uses
# only portable C99 and no Zephyr APIs directly, so it builds across Zephyr 3.7
# LTS through main. The native_sim sample is verified to compile and link green
# in CI (see the zephyr-validation job in .github/workflows/ci.yml).
#
# For production, do NOT use this file: add iolinki-master and iolinki as
# projects entries in your OWN west.yml pinned to your chosen Zephyr/SDK.
manifest:
  self:
    # iolinki-master is the manifest repo; it is also a Zephyr module via
    # zephyr/module.yml.
    path: iolinki-master
    west-commands: ""

  remotes:
    - name: zephyrproject-rtos
      url-base: https://github.com/zephyrproject-rtos
    - name: w1ne
      url-base: https://github.com/w1ne

  projects:
    # The iolinki device stack is a Zephyr module too; the master reuses its
    # frame/CRC helper sources and <iolinki/*.h> headers.
    - name: iolinki
      remote: w1ne
      revision: develop
      path: iolinki

    - name: zephyr
      remote: zephyrproject-rtos
      revision: main
      import: true
```

## third_party/iolinki-master/zephyr/Kconfig
```kconfig
# Copyright (C) 2026 Andrii Shylenko
# SPDX-License-Identifier: GPL-3.0-or-later

menuconfig IOLINKI_MASTER
    bool "IO-Link Master Stack"
    default y
    help
      Enable the iolinki IO-Link Master Stack. This module implements the
      master-side IO-Link Data Link Layer, ISDU engine, parameter/data-storage
      handling and SIO fallback, driving a device through a hardware-agnostic
      PHY abstraction (iolink_phy_api_t). It reuses the shared frame/CRC helper
      sources and public <iolinki/*.h> headers from the iolinki device stack,
      which must be present in the same west workspace (see west.yml).

if IOLINKI_MASTER

config IOLINKI_MASTER_CONTROLLER
    bool "Multi-port master controller helpers"
    default y
    help
      Build the multi-port controller layer (iolink_master_controller_*), which
      manages an array of ports from a single tick/scheduling entry point. The
      controller sources are always compiled with the master library; this
      symbol is provided so applications can gate controller-only code.

endif # IOLINKI_MASTER
```
