## crates/firmware-curiosity-pic32mz-nuttx/board/Kconfig
```kconfig
config CURIOSITY_PIC32MZ_EF
	bool
	default y
	select ARCH_HAVE_LEDS
	---help---
		Microchip Curiosity PIC32MZ EF 2.0 (DM320209): three user LEDs
		(LED1 RJ7, LED2 RK7, LED3 RJ3) for the user LED driver.
```

## crates/firmware-curiosity-pic32mz-nuttx/board/configs/nsh/defconfig
```kconfig
# CONFIG_ARCH_LEDS is not set
# CONFIG_ARCH_RAMFUNCS is not set
# CONFIG_MIPS_MICROMIPS is not set
CONFIG_ARCH="mips"
CONFIG_ARCH_BOARD_CUSTOM=y
CONFIG_ARCH_BOARD_CUSTOM_DIR="../labwired-board"
CONFIG_ARCH_BOARD_CUSTOM_DIR_RELPATH=y
CONFIG_ARCH_BOARD_CUSTOM_NAME="curiosity-pic32mz-ef"
CONFIG_ARCH_CHIP="pic32mz"
CONFIG_ARCH_CHIP_PIC32MZ2048EFM=y
CONFIG_ARCH_CHIP_PIC32MZ=y
CONFIG_ARCH_CHIP_PIC32MZEF=y
CONFIG_ARCH_MIPS=y
CONFIG_ARCH_STACKDUMP=y
CONFIG_BOARDCTL=y
CONFIG_BOARD_LOOPSPERMSEC=7245
CONFIG_BUILTIN=y
CONFIG_EXAMPLES_HELLO=y
CONFIG_FS_PROCFS=y
CONFIG_IDLETHREAD_STACKSIZE=2048
CONFIG_INIT_ENTRYPOINT="nsh_main"
CONFIG_LINE_MAX=64
CONFIG_MIPS32_TOOLCHAIN_GNU_ELF=y
CONFIG_NSH_ARCHINIT=y
CONFIG_NSH_BUILTIN_APPS=y
CONFIG_NSH_FILEIOSIZE=512
CONFIG_NSH_READLINE=y
CONFIG_PIC32MZ_ICESEL_CH1=y
CONFIG_PIC32MZ_UART2=y
CONFIG_PREALLOC_TIMERS=4
CONFIG_RAM_SIZE=524288
CONFIG_RAM_START=0xa0000000
CONFIG_RR_INTERVAL=200
CONFIG_SCHED_WAITPID=y
CONFIG_START_DAY=1
CONFIG_START_MONTH=11
CONFIG_START_YEAR=2026
CONFIG_SYSTEM_NSH=y
CONFIG_UART2_SERIAL_CONSOLE=y
CONFIG_USERLED=y
CONFIG_USERLED_LOWER=y
```

## crates/firmware-curiosity-pic32mz-nuttx/board/configs/ostest/defconfig
```kconfig
# CONFIG_ARCH_LEDS is not set
# CONFIG_ARCH_RAMFUNCS is not set
# CONFIG_MIPS_MICROMIPS is not set
CONFIG_ARCH="mips"
CONFIG_ARCH_BOARD_CUSTOM=y
CONFIG_ARCH_BOARD_CUSTOM_DIR="../labwired-board"
CONFIG_ARCH_BOARD_CUSTOM_DIR_RELPATH=y
CONFIG_ARCH_BOARD_CUSTOM_NAME="curiosity-pic32mz-ef"
CONFIG_ARCH_CHIP="pic32mz"
CONFIG_ARCH_CHIP_PIC32MZ2048EFM=y
CONFIG_ARCH_CHIP_PIC32MZ=y
CONFIG_ARCH_CHIP_PIC32MZEF=y
CONFIG_ARCH_MIPS=y
CONFIG_ARCH_STACKDUMP=y
CONFIG_BOARDCTL=y
CONFIG_BOARD_LOOPSPERMSEC=7245
CONFIG_FS_NAMED_SEMAPHORES=y
CONFIG_FS_PROCFS=y
CONFIG_IDLETHREAD_STACKSIZE=2048
CONFIG_INIT_ENTRYPOINT="ostest_main"
CONFIG_MIPS32_TOOLCHAIN_GNU_ELF=y
CONFIG_PIC32MZ_ICESEL_CH1=y
CONFIG_PIC32MZ_UART2=y
CONFIG_PREALLOC_TIMERS=4
CONFIG_PRIORITY_INHERITANCE=y
CONFIG_PTHREAD_CLEANUP_STACKSIZE=4
CONFIG_PTHREAD_MUTEX_TYPES=y
CONFIG_RAM_SIZE=524288
CONFIG_RAM_START=0xa0000000
CONFIG_RR_INTERVAL=200
CONFIG_SCHED_CHILD_STATUS=y
CONFIG_SCHED_HAVE_PARENT=y
CONFIG_SCHED_WAITPID=y
CONFIG_SEM_PREALLOCHOLDERS=8
CONFIG_SIG_EVTHREAD=y
CONFIG_START_DAY=1
CONFIG_START_MONTH=11
CONFIG_START_YEAR=2026
CONFIG_TESTING_OSTEST=y
CONFIG_TESTING_OSTEST_LOOPS=1
CONFIG_TLS_NCLEANUP=4
CONFIG_UART2_SERIAL_CONSOLE=y
```
